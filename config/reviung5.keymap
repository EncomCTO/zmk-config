/*
 * Copyright (c) 2022 The ZMK Contributors
 *
 * SPDX-License-Identifier: MIT
 */

#include <behaviors.dtsi>
#include <dt-bindings/zmk/keys.h>
#include <dt-bindings/zmk/bt.h>
#include <dt-bindings/zmk/outputs.h>

#define BASE 0
#define BLE 1

/ {
        keymap {
            compatible = "zmk,keymap";

            base_layer {
              label = "BASE";
              bindings = <
                // ╭─────────────┬──────────────┬──────────────────┬─────────────┬─────────────╮
                     &kp LG(LS(A))     &kp C_VOL_DN  &kp C_PLAY_PAUSE    &kp C_VOL_UP   &kp LG(LS(V)) 
                // ╰─────────────┴──────────────┴──────────────────┴─────────────┴─────────────╯
              >;
              //sensor-bindings = <&inc_dec_kp C_VOL_UP C_VOL_DN>;
            };

            ble_layer {
              label = "BLE";
              bindings = <
                // ╭─────────────┬─────────────┬─────────────┬─────────────┬─────────────╮
                     &trans     &out OUT_TOG   &bt BT_PRV    &bt BT_NXT    &bt BT_CLR
                // ╰─────────────┴─────────────┴─────────────┴─────────────┴─────────────╯
              >;
            };
        };
};
